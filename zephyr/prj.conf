## CMakeLists.txt
```
cmake_minimum_required(VERSION 3.20.0)
find_package(Zephyr REQUIRED HINTS $ENV{ZEPHYR_BASE})
project(em_intro)

# map .sdram_bss section to SDRAM2 memory region
zephyr_linker_sources(SECTIONS sdram.ld)

target_sources(app PRIVATE
    src/main.c
    src/graph.c
    src/font.c
    src/sprite.c
    src/fire.c
    src/floor.c
    src/stars.c
    src/logo.c
    src/scroller.c
)
```

## prj.conf
```kconfig
# Display
CONFIG_DISPLAY=y

# FPU (M7 has single-precision hardware FPU)
CONFIG_FPU=y
CONFIG_FPU_SHARING=y

# SDRAM / FMC
CONFIG_MEMC=y

# C library with math support
CONFIG_NEWLIB_LIBC=y

# Stack
CONFIG_MAIN_STACK_SIZE=8192

# Logging
CONFIG_LOG=y
CONFIG_LOG_DEFAULT_LEVEL=3
```

## boards/stm32h747i_disco_stm32h747xx_m7.overlay
```dts
#include <zephyr/dt-bindings/memory-attr/memory-attr-arm.h>

/*
 * SDRAM2: 32 MB at 0xD0000000
 * - zephyr,memory-region creates linker MEMORY region "SDRAM2"
 * - non-cacheable MPU attribute needed for LTDC DMA coherency
 */
&sdram2 {
    status = "okay";
    zephyr,memory-region = "SDRAM2";
    zephyr,memory-attr = <( DT_MEM_ARM(ATTR_MPU_RAM_NOCACHE) )>;
};
```

## src/main.c
```c
// --- em-intro demoscene demo ---
// Zephyr build: STM32H747I-DISCO bare metal
// Emscripten build: browser via WebAssembly

#ifdef __EMSCRIPTEN__
#include <emscripten/emscripten.h>
#include <emscripten/html5.h>
#else
#include <zephyr/kernel.h>
#endif

#include "graph.h"
#include "font.h"
#include "fire.h"
#include "floor.h"
#include "stars.h"
#include "logo.h"
#include "scroller.h"

// --- scene config ---
static const char SCROLL_TEXT[] =
    "GREETINGS FROM THE CODERS OF TOMORROW ... "
    "THIS INTRO WAS CRAFTED BY A HUMAN AND AN AI WORKING TOGETHER ... "
    "NO PIXELS WERE HARMED IN THE MAKING OF THIS DEMO ... "
    "RESPECT TO ALL OLDSCHOOL SCENERS OUT THERE ...";

#define SCROLL_SPEED  50.0f
#define SCROLL_Y      24

// --- timing ---
static float time_now = 0.0f;
static float dt = 0.0f;
static float fire_acc = 0.0f;

// --- scroller state ---
static scroller_t scroller;
static bool scroller_active = false;

// advance all effects by one frame
static void update(void)
{
    if (logo_is_done()) {
        fire_acc += dt;
        while (fire_acc >= FIRE_RATE) {
            fire_update();
            fire_acc -= FIRE_RATE;
        }
    }
    stars_update(dt);
    logo_update(dt);
    if (scroller_active) {
        scroller_update(&scroller, dt);
    }
}

// render all effects to framebuffer in back-to-front order
static void draw(void)
{
    fb_clear(0);
    stars_draw();
    if (logo_is_done()) {
        fire_draw();
    }
    floor_draw();
    logo_draw();
    if (scroller_active) {
        scroller_draw(&scroller, time_now);
    }
}

// === Emscripten main loop ===
#ifdef __EMSCRIPTEN__

// JS-side function to blit the RGBA buffer to canvas
EM_JS(void, js_blit_canvas, (const uint8_t *buf, int w, int h), {
    var canvas = document.getElementById('screen')
              || document.getElementById('c');
    if (!canvas) { console.error('no canvas found'); return; }
    var ctx = canvas.getContext('2d');
    var img = ctx.createImageData(w, h);
    img.data.set(HEAPU8.subarray(buf, buf + w * h * 4));
    ctx.putImageData(img, 0, 0);
});

static double last_time = 0.0;

static void em_frame(void)
{
    double now = emscripten_get_now() / 1000.0;
    dt = (float)(now - last_time);
    last_time = now;

    // clamp dt to avoid huge jumps
    if (dt > 0.1f) dt = 0.1f;

    time_now += dt;

    // create scroller once logo animation is done
    if (!scroller_active && logo_is_done()) {
        scroller_create(&scroller, SCROLL_TEXT, SCROLL_SPEED, SCROLL_Y);
        scroller_active = true;
    }

    update();
    draw();
    fb_swap();

    // blit RGBA buffer to canvas
    js_blit_canvas(graph_get_canvas_buf(), SCREEN_W, SCREEN_H);
}

int main(void)
{
    graph_init();
    font_init();
    fire_init();
    floor_init();
    stars_init();
    logo_init();

    last_time = emscripten_get_now() / 1000.0;

    // 0 = use requestAnimationFrame, 1 = simulate infinite loop
    emscripten_set_main_loop(em_frame, 0, 1);

    return 0;
}

#else
// === Zephyr main loop ===

int main(void)
{
    // initialize display
    int ret = graph_init();
    if (ret < 0) {
        printk("Display init failed: %d\n", ret);
        return ret;
    }

    // initialize all effects
    font_init();
    fire_init();
    floor_init();
    stars_init();
    logo_init();

    printk("em-intro: all effects initialized, entering main loop\n");

    // main loop
    int64_t last_ms = k_uptime_get();

    while (1) {
        int64_t now_ms = k_uptime_get();
        dt = (float)(now_ms - last_ms) / 1000.0f;
        last_ms = now_ms;

        // clamp dt to avoid huge jumps on first frame or debugger pause
        if (dt > 0.1f) dt = 0.1f;

        time_now += dt;

        // create scroller once logo animation is done (fire starts)
        if (!scroller_active && logo_is_done()) {
            scroller_create(&scroller, SCROLL_TEXT, SCROLL_SPEED, SCROLL_Y);
            scroller_active = true;
        }

        update();
        draw();
        fb_swap();

        // target ~60fps (16ms per frame)
        int64_t elapsed = k_uptime_get() - now_ms;
        if (elapsed < 16) {
            k_msleep(16 - (int)elapsed);
        }
    }

    return 0;
}

#endif
```

## src/fire.c
```c
// --- fire effect ---

#include "fire.h"
#include "graph.h"
#include "prng.h"
#include <string.h>

#define FIRE_H_SIZE  42
#define FIRE_TOP_Y   (HORIZON_Y - 40)
#define FIRE_COOLING 4

static uint8_t fire_buf[SCREEN_W * FIRE_H_SIZE];
static uint16_t fire_pal[256];

static uint32_t fire_rng = 12345;

// build fire palette: black -> red -> yellow -> white (256 entries)
void fire_init(void)
{
    for (int i = 0; i < 64; i++)
        fire_pal[i] = rgb565(i * 4, 0, 0);
    for (int i = 64; i < 128; i++)
        fire_pal[i] = rgb565(255, (i - 64) * 4, 0);
    for (int i = 128; i < 192; i++)
        fire_pal[i] = rgb565(255, 255, (i - 128) * 4);
    for (int i = 192; i < 256; i++)
        fire_pal[i] = rgb565(255, 255, 255);

    memset(fire_buf, 0, sizeof(fire_buf));
}

// one step of fire simulation: seed bottom rows, average and propagate up
void fire_update(void)
{
    // seed bottom two rows
    for (int x = 0; x < SCREEN_W; x++) {
        fire_buf[(FIRE_H_SIZE - 1) * SCREEN_W + x] = (uint8_t)lcg_next(&fire_rng);
        fire_buf[(FIRE_H_SIZE - 2) * SCREEN_W + x] = (uint8_t)lcg_next(&fire_rng);
    }

    // average 4 neighbors, propagate upward
    for (int y = 0; y < FIRE_H_SIZE - 2; y++) {
        for (int x = 0; x < SCREEN_W; x++) {
            int xl = (x > 0) ? x - 1 : SCREEN_W - 1;
            int xr = (x < SCREEN_W - 1) ? x + 1 : 0;

            int sum = fire_buf[(y + 1) * SCREEN_W + xl]
                    + fire_buf[(y + 1) * SCREEN_W + x]
                    + fire_buf[(y + 1) * SCREEN_W + xr]
                    + fire_buf[(y + 2) * SCREEN_W + x];

            int val = (sum >> 2) - FIRE_COOLING;
            if (val < 0) val = 0;
            fire_buf[y * SCREEN_W + x] = (uint8_t)val;
        }
    }
}

// render fire buffer to framebuffer using the heat palette
void fire_draw(void)
{
    for (int y = 0; y < FIRE_H_SIZE - 4; y++) {
        int sy = FIRE_TOP_Y + y;
        if ((unsigned)sy >= SCREEN_H) continue;
        int fb_row = sy * SCREEN_W;
        int fire_row = y * SCREEN_W;
        for (int x = 0; x < SCREEN_W; x++) {
            uint8_t heat = fire_buf[fire_row + x];
            if (heat > 0) {
                fb_back[fb_row + x] = fire_pal[heat];
            }
        }
    }
}
```

## src/fire.h
```c
#ifndef FIRE_H
#define FIRE_H

#define FIRE_RATE (1.0f / 20.0f)

// build fire palette: black -> red -> yellow -> white
void fire_init(void);

// one step of fire simulation: seed bottom rows, average and propagate up
void fire_update(void);

// render fire buffer to framebuffer using the heat palette
void fire_draw(void);

#endif
```

## src/floor.c
```c
// --- checkerboard floor ---

#include "floor.h"
#include "graph.h"

#define FLOOR_Z_NEAR  1.0f
#define FLOOR_Z_FAR   6.0f
#define FLOOR_FOCAL   96.0f
#define FLOOR_ROWS    (SCREEN_H - HORIZON_Y)

static const float INV_Z_NEAR = 1.0f / FLOOR_Z_NEAR;
static const float INV_Z_FAR  = 1.0f / FLOOR_Z_FAR;

static uint16_t col_red;
static uint16_t col_white;

// pre-compute tile colors
void floor_init(void)
{
    col_red   = rgb565(180, 40, 40);
    col_white = rgb565(220, 220, 220);
}

// render perspective checkerboard floor from horizon to screen bottom
void floor_draw(void)
{
    for (int y = HORIZON_Y - 4; y < SCREEN_H; y++) {
        float t = (float)(SCREEN_H - 1 - y) / (float)(FLOOR_ROWS - 1);
        float z = 1.0f / (INV_Z_NEAR + (INV_Z_FAR - INV_Z_NEAR) * t);
        int tz = (int)z;
        int fb_row = y * SCREEN_W;

        for (int x = 0; x < SCREEN_W; x++) {
            float wx = (float)(x - SCREEN_W / 2) * z / FLOOR_FOCAL;
            int tx = (wx >= 0.0f) ? (int)wx : ((int)wx - 1);
            int tile = (tx + tz) & 1;
            fb_back[fb_row + x] = tile ? col_red : col_white;
        }
    }
}
```

## src/floor.h
```c
#ifndef FLOOR_H
#define FLOOR_H

// pre-compute tile colors
void floor_init(void);

// render perspective checkerboard floor from horizon to screen bottom
void floor_draw(void);

#endif
```

## src/font.c
```c
// --- procedural demoscene chrome font ---
//
// Generates chunky angular bitmap glyphs at init time.
// Each character is defined on a 5x7 cell grid, then scaled up
// and filled with a chrome gradient (steel-blue -> bright -> copper).
// All glyphs are pre-rendered into a flat atlas for fast blitting.

#include "font.h"
#include "graph.h"

// --- font state ---
static uint16_t font_grad[FONT_GLYPH_H];
static uint16_t font_atlas[FONT_ATLAS_W * FONT_GLYPH_H];

// glyph bitmaps: 64 chars * 7 rows, indexed as (ch - FONT_FIRST) * FONT_GH
// 5 bits per row, MSB = left column
static const uint8_t font_map[FONT_COUNT * FONT_GH] = {
    // space (32)
    0x00, 0x00, 0x00, 0x00, 0x00, 0x00, 0x00,
    // ! (33)
    0x04, 0x04, 0x04, 0x04, 0x04, 0x00, 0x04,
    // " (34)
    0x0A, 0x0A, 0x0A, 0x00, 0x00, 0x00, 0x00,
    // # (35)
    0x0A, 0x1F, 0x0A, 0x0A, 0x1F, 0x0A, 0x00,
    // $ (36)
    0x00, 0x00, 0x00, 0x00, 0x00, 0x00, 0x00,
    // % (37)
    0x00, 0x00, 0x00, 0x00, 0x00, 0x00, 0x00,
    // & (38)
    0x00, 0x00, 0x00, 0x00, 0x00, 0x00, 0x00,
    // ' (39)
    0x04, 0x04, 0x00, 0x00, 0x00, 0x00, 0x00,
    // ( (40)
    0x02, 0x04, 0x08, 0x08, 0x08, 0x04, 0x02,
    // ) (41)
    0x08, 0x04, 0x02, 0x02, 0x02, 0x04, 0x08,
    // * (42)
    0x00, 0x04, 0x15, 0x0E, 0x15, 0x04, 0x00,
    // + (43)
    0x00, 0x04, 0x04, 0x1F, 0x04, 0x04, 0x00,
    // , (44)
    0x00, 0x00, 0x00, 0x00, 0x00, 0x04, 0x08,
    // - (45)
    0x00, 0x00, 0x00, 0x1F, 0x00, 0x00, 0x00,
    // . (46)
    0x00, 0x00, 0x00, 0x00, 0x00, 0x00, 0x04,
    // / (47)
    0x01, 0x01, 0x02, 0x04, 0x08, 0x10, 0x10,
    // 0 (48)
    0x1F, 0x11, 0x13, 0x15, 0x19, 0x11, 0x1F,
    // 1 (49)
    0x04, 0x0C, 0x04, 0x04, 0x04, 0x04, 0x1F,
    // 2 (50)
    0x1F, 0x01, 0x01, 0x1F, 0x10, 0x10, 0x1F,
    // 3 (51)
    0x1F, 0x01, 0x01, 0x1F, 0x01, 0x01, 0x1F,
    // 4 (52)
    0x11, 0x11, 0x11, 0x1F, 0x01, 0x01, 0x01,
    // 5 (53)
    0x1F, 0x10, 0x10, 0x1F, 0x01, 0x01, 0x1F,
    // 6 (54)
    0x1F, 0x10, 0x10, 0x1F, 0x11, 0x11, 0x1F,
    // 7 (55)
    0x1F, 0x01, 0x02, 0x04, 0x08, 0x08, 0x08,
    // 8 (56)
    0x1F, 0x11, 0x11, 0x1F, 0x11, 0x11, 0x1F,
    // 9 (57)
    0x1F, 0x11, 0x11, 0x1F, 0x01, 0x01, 0x1F,
    // : (58)
    0x00, 0x00, 0x04, 0x00, 0x04, 0x00, 0x00,
    // ; (59)
    0x00, 0x00, 0x00, 0x00, 0x00, 0x00, 0x00,
    // < (60)
    0x00, 0x00, 0x00, 0x00, 0x00, 0x00, 0x00,
    // = (61)
    0x00, 0x00, 0x1F, 0x00, 0x1F, 0x00, 0x00,
    // > (62)
    0x00, 0x00, 0x00, 0x00, 0x00, 0x00, 0x00,
    // ? (63)
    0x1F, 0x11, 0x01, 0x06, 0x04, 0x00, 0x04,
    // @ (64)
    0x00, 0x00, 0x00, 0x00, 0x00, 0x00, 0x00,
    // A (65)
    0x1F, 0x11, 0x11, 0x1F, 0x11, 0x11, 0x11,
    // B (66)
    0x1E, 0x11, 0x11, 0x1E, 0x11, 0x11, 0x1E,
    // C (67)
    0x1F, 0x10, 0x10, 0x10, 0x10, 0x10, 0x1F,
    // D (68)
    0x1E, 0x11, 0x11, 0x11, 0x11, 0x11, 0x1E,
    // E (69)
    0x1F, 0x10, 0x10, 0x1E, 0x10, 0x10, 0x1F,
    // F (70)
    0x1F, 0x10, 0x10, 0x1E, 0x10, 0x10, 0x10,
    // G (71)
    0x1F, 0x10, 0x10, 0x17, 0x11, 0x11, 0x1F,
    // H (72)
    0x11, 0x11, 0x11, 0x1F, 0x11, 0x11, 0x11,
    // I (73)
    0x1F, 0x04, 0x04, 0x04, 0x04, 0x04, 0x1F,
    // J (74)
    0x1F, 0x01, 0x01, 0x01, 0x01, 0x11, 0x1F,
    // K (75)
    0x11, 0x12, 0x14, 0x18, 0x14, 0x12, 0x11,
    // L (76)
    0x10, 0x10, 0x10, 0x10, 0x10, 0x10, 0x1F,
    // M (77)
    0x11, 0x1B, 0x15, 0x15, 0x11, 0x11, 0x11,
    // N (78)
    0x11, 0x19, 0x15, 0x13, 0x11, 0x11, 0x11,
    // O (79)
    0x1F, 0x11, 0x11, 0x11, 0x11, 0x11, 0x1F,
    // P (80)
    0x1F, 0x11, 0x11, 0x1F, 0x10, 0x10, 0x10,
    // Q (81)
    0x1F, 0x11, 0x11, 0x11, 0x15, 0x12, 0x1F,
    // R (82)
    0x1F, 0x11, 0x11, 0x1F, 0x14, 0x12, 0x11,
    // S (83)
    0x1F, 0x10, 0x10, 0x1F, 0x01, 0x01, 0x1F,
    // T (84)
    0x1F, 0x04, 0x04, 0x04, 0x04, 0x04, 0x04,
    // U (85)
    0x11, 0x11, 0x11, 0x11, 0x11, 0x11, 0x1F,
    // V (86)
    0x11, 0x11, 0x11, 0x11, 0x0A, 0x0A, 0x04,
    // W (87)
    0x11, 0x11, 0x11, 0x15, 0x15, 0x1B, 0x11,
    // X (88)
    0x11, 0x11, 0x0A, 0x04, 0x0A, 0x11, 0x11,
    // Y (89)
    0x11, 0x11, 0x0A, 0x04, 0x04, 0x04, 0x04,
    // Z (90)
    0x1F, 0x01, 0x02, 0x04, 0x08, 0x10, 0x1F,
    // [ (91)
    0x00, 0x00, 0x00, 0x00, 0x00, 0x00, 0x00,
    // backslash (92)
    0x00, 0x00, 0x00, 0x00, 0x00, 0x00, 0x00,
    // ] (93)
    0x00, 0x00, 0x00, 0x00, 0x00, 0x00, 0x00,
    // ^ (94)
    0x00, 0x00, 0x00, 0x00, 0x00, 0x00, 0x00,
    // _ (95)
    0x00, 0x00, 0x00, 0x00, 0x00, 0x00, 0x1F,
};

// --- gradient helpers ---

// brighten (amt > 0) or darken (amt < 0) an RGB565 color by amt units
static uint16_t font_adjust(uint16_t c, int amt)
{
    int r = (((c >> 11) & 0x1F) << 3) + amt;
    int g = (((c >> 5) & 0x3F) << 2) + amt;
    int b = ((c & 0x1F) << 3) + amt;
    if (r < 0) r = 0; if (r > 255) r = 255;
    if (g < 0) g = 0; if (g > 255) g = 255;
    if (b < 0) b = 0; if (b > 255) b = 255;
    return rgb565((uint8_t)r, (uint8_t)g, (uint8_t)b);
}

// build chrome gradient lookup table for each glyph scanline
static void font_build_gradient(void)
{
    // chrome: steel-blue top -> bright highlight -> warm copper bottom
    static const float stop_t[7] = { 0.00f, 0.20f, 0.38f, 0.45f, 0.55f, 0.75f, 1.00f };
    static const float stop_r[7] = {   40,    80,   170,   230,   200,   160,    80 };
    static const float stop_g[7] = {   50,   100,   180,   225,   170,   120,    55 };
    static const float stop_b[7] = {  110,   170,   210,   220,   100,    60,    30 };

    for (int y = 0; y < FONT_GLYPH_H; y++) {
        float t = (float)y / (float)(FONT_GLYPH_H - 1);

        // find enclosing stops
        int si = 0;
        for (int s = 1; s < 7; s++) {
            if (stop_t[s] >= t) { si = s - 1; break; }
        }

        float lt = (t - stop_t[si]) / (stop_t[si + 1] - stop_t[si]);
        float r = stop_r[si] + (stop_r[si + 1] - stop_r[si]) * lt;
        float g = stop_g[si] + (stop_g[si + 1] - stop_g[si]) * lt;
        float b = stop_b[si] + (stop_b[si + 1] - stop_b[si]) * lt;

        // scanline groove: dim every other row for textured chrome look
        if (y & 1) {
            r *= 0.82f;
            g *= 0.82f;
            b *= 0.82f;
        }

        font_grad[y] = rgb565((uint8_t)r, (uint8_t)g, (uint8_t)b);
    }
}

// rasterize all glyphs into a flat atlas with chrome gradient and bevel
static void font_render_atlas(void)
{
    for (int ci = 0; ci < FONT_COUNT; ci++) {
        int base = ci * FONT_GH;
        int ox = ci * FONT_GLYPH_W;

        for (int gy = 0; gy < FONT_GH; gy++) {
            uint8_t row = font_map[base + gy];
            if (row == 0) continue;

            // rows above/below for bevel detection
            uint8_t row_above = (gy > 0) ? font_map[base + gy - 1] : 0;
            uint8_t row_below = (gy < FONT_GH - 1) ? font_map[base + gy + 1] : 0;

            for (int gx = 0; gx < FONT_GW; gx++) {
                uint8_t bit = 1 << (FONT_GW - 1 - gx);
                if (!(row & bit)) continue;

                int is_top = !(row_above & bit);
                int is_bot = !(row_below & bit);

                int px_x = ox + gx * FONT_SCALE;
                for (int py = 0; py < FONT_SCALE; py++) {
                    int ay = gy * FONT_SCALE + py;
                    uint16_t color = font_grad[ay];

                    // bevel: bright top edge, dark bottom edge
                    if (is_top && py == 0) {
                        color = font_adjust(color, 50);
                    }
                    if (is_bot && py == FONT_SCALE - 1) {
                        color = font_adjust(color, -40);
                    }

                    for (int px = 0; px < FONT_SCALE; px++) {
                        font_atlas[ay * FONT_ATLAS_W + px_x + px] = color;
                    }
                }
            }
        }
    }
}

// build gradient, define chars, render atlas — call once at startup
void font_init(void)
{
    font_build_gradient();
    font_render_atlas();
}

// blit one character from atlas to framebuffer at (x, y)
void font_draw_char(int code, int x, int y)
{
    // map lowercase to uppercase
    if (code >= 97 && code <= 122) code -= 32;
    if (code < FONT_FIRST || code >= FONT_FIRST + FONT_COUNT) return;

    int ox = (code - FONT_FIRST) * FONT_GLYPH_W;

    for (int gy = 0; gy < FONT_GLYPH_H; gy++) {
        int sy = y + gy;
        if ((unsigned)sy >= SCREEN_H) continue;
        int fb_row = sy * SCREEN_W;
        int atlas_row = gy * FONT_ATLAS_W + ox;
        for (int gx = 0; gx < FONT_GLYPH_W; gx++) {
            uint16_t c = font_atlas[atlas_row + gx];
            if (c == 0) continue;
            int sx = x + gx;
            if ((unsigned)sx >= SCREEN_W) continue;
            fb_back[fb_row + sx] = c;
        }
    }
}
```

## src/font.h
```c
#ifndef FONT_H
#define FONT_H

#include <stdint.h>

#define FONT_GW       5
#define FONT_GH       7
#define FONT_SCALE    4
#define FONT_GLYPH_W  (FONT_GW * FONT_SCALE)
#define FONT_GLYPH_H  (FONT_GH * FONT_SCALE)
#define FONT_SPACING  2
#define FONT_FIRST    32
#define FONT_COUNT    64
#define FONT_ATLAS_W  (FONT_COUNT * FONT_GLYPH_W)

// build gradient, define chars, render atlas — call once at startup
void font_init(void);

// blit one character from atlas to framebuffer at (x, y)
void font_draw_char(int code, int x, int y);

#endif
```

## src/graph.c
```c
// --- screen setup and framebuffer ---
// Zephyr build: display via Zephyr display API
// Emscripten build: blit RGB565 → RGBA32 to HTML canvas

#include "graph.h"
#include <string.h>

// ===== Platform-specific framebuffers and state =====

#ifdef __EMSCRIPTEN__
#include <emscripten/emscripten.h>

static uint16_t fb0[SCREEN_W * SCREEN_H];
static uint16_t fb1[SCREEN_W * SCREEN_H];

// RGBA32 output buffer — JS reads this for canvas putImageData
static uint8_t canvas_buf[SCREEN_W * SCREEN_H * 4];

EMSCRIPTEN_KEEPALIVE
uint8_t *graph_get_canvas_buf(void) { return canvas_buf; }

#else
#include <zephyr/kernel.h>
#include <zephyr/device.h>
#include <zephyr/drivers/display.h>

// two framebuffers placed in SDRAM via linker — see board overlay
static uint16_t fb0[SCREEN_W * SCREEN_H] SDRAM_BSS;
static uint16_t fb1[SCREEN_W * SCREEN_H] SDRAM_BSS;

static const struct device *display_dev;
static int display_x_offset = 0;
static int display_y_offset = 0;

#endif

// ===== Common double-buffer state =====

static uint16_t *buffers[2] = { fb0, fb1 };
static int back_idx = 0;
uint16_t *fb_back = NULL;

// ===== Platform-specific init =====

#ifdef __EMSCRIPTEN__

int graph_init(void)
{
    memset(fb0, 0, sizeof(fb0));
    memset(fb1, 0, sizeof(fb1));
    back_idx = 0;
    fb_back = buffers[back_idx];
    return 0;
}

#else

// initialize display device and framebuffers
int graph_init(void)
{
    display_dev = DEVICE_DT_GET(DT_CHOSEN(zephyr_display));
    if (!device_is_ready(display_dev)) {
        return -1;
    }

    display_blanking_off(display_dev);

    // center our 480x272 buffer on the physical display
    struct display_capabilities caps;
    display_get_capabilities(display_dev, &caps);
    if (caps.x_resolution > SCREEN_W) {
        display_x_offset = (caps.x_resolution - SCREEN_W) / 2;
    }
    if (caps.y_resolution > SCREEN_H) {
        display_y_offset = (caps.y_resolution - SCREEN_H) / 2;
    }

    memset(fb0, 0, sizeof(fb0));
    memset(fb1, 0, sizeof(fb1));
    back_idx = 0;
    fb_back = buffers[back_idx];

    return 0;
}

#endif

// ===== Common framebuffer operations =====

// fill entire back buffer with a single color
void fb_clear(uint16_t color)
{
    if (color == 0) {
        memset(fb_back, 0, SCREEN_W * SCREEN_H * sizeof(uint16_t));
    } else {
        for (int i = 0; i < SCREEN_W * SCREEN_H; i++) {
            fb_back[i] = color;
        }
    }
}

// ===== Platform-specific swap =====

#ifdef __EMSCRIPTEN__

// expand RGB565 back buffer → RGBA32 canvas buffer, then swap
void fb_swap(void)
{
    const uint16_t *src = fb_back;
    uint8_t *dst = canvas_buf;
    for (int i = 0; i < SCREEN_W * SCREEN_H; i++) {
        uint16_t c = src[i];
        dst[0] = (c >> 8) & 0xF8; dst[0] |= dst[0] >> 5;  // R
        dst[1] = (c >> 3) & 0xFC; dst[1] |= dst[1] >> 6;  // G
        dst[2] = (c << 3) & 0xF8; dst[2] |= dst[2] >> 5;  // B
        dst[3] = 255;                                        // A
        dst += 4;
    }

    back_idx ^= 1;
    fb_back = buffers[back_idx];
}

#else

// present back buffer to display, swap buffers
void fb_swap(void)
{
    struct display_buffer_descriptor desc = {
        .buf_size = SCREEN_W * SCREEN_H * 2,
        .width = SCREEN_W,
        .height = SCREEN_H,
        .pitch = SCREEN_W,
    };

    display_write(display_dev, display_x_offset, display_y_offset,
                  &desc, fb_back);

    back_idx ^= 1;
    fb_back = buffers[back_idx];
}

#endif
```

## src/graph.h
```c
#ifndef GRAPH_H
#define GRAPH_H

#include <stdint.h>

// place large buffers in external SDRAM on Zephyr, regular memory elsewhere
#if defined(__EMSCRIPTEN__) || defined(SYNTAX_CHECK)
#define SDRAM_BSS
#else
#define SDRAM_BSS __attribute__((section(".sdram_bss")))
#endif

// --- resolution (change these!) ---
#define SCREEN_W  480
#define SCREEN_H  272
#define HORIZON_Y (SCREEN_H * 3 / 4)

// current back buffer — effects write pixels here
extern uint16_t *fb_back;

// initialize display device and framebuffers
int graph_init(void);

// pack 8-bit RGB into 16-bit RGB565
static inline uint16_t rgb565(uint8_t r, uint8_t g, uint8_t b)
{
    return ((r & 0xF8) << 8) | ((g & 0xFC) << 3) | (b >> 3);
}

// write one RGB565 pixel to back buffer with bounds check
static inline void putpixel(int x, int y, uint16_t color)
{
    if ((unsigned)x < SCREEN_W && (unsigned)y < SCREEN_H) {
        fb_back[y * SCREEN_W + x] = color;
    }
}

// fill entire back buffer with a single color
void fb_clear(uint16_t color);

// present back buffer to display, swap buffers
void fb_swap(void);

#ifdef __EMSCRIPTEN__
// get pointer to RGBA32 canvas buffer (Emscripten only)
uint8_t *graph_get_canvas_buf(void);
#endif

#endif
```

## src/logo.c
```c
// --- logo particle animation ---

#include "logo.h"
#include "graph.h"
#include "sprite.h"
#include "logo_data.h"
#include <math.h>

#ifndef M_PI
#define M_PI 3.14159265358979323846
#endif

#define LOGO_ANIM_TIME      4.0f
#define LOGO_WAVE_TIME      2.5f
#define LOGO_WAVE_MAX       15.0f
#define LOGO_TOTAL_TIME     (LOGO_ANIM_TIME + LOGO_WAVE_TIME)

// periodic shake
#define LOGO_SHAKE_INTERVAL 10.0f
#define LOGO_SHAKE_DURATION 0.8f
#define LOGO_SHAKE_AMP      6.0f
#define LOGO_SHAKE_FREQ     0.15f   // spatial frequency of shake sine
#define LOGO_SHAKE_SPEED    8.0f    // temporal speed of shake sine

// display scale
#define LOGO_SCALE          0.5f    // fraction of screen width
#define LOGO_Y_OFFSET       20      // pixels below vertical center

// convergence wave tuning
#define LOGO_CONV_SPEED     4.0f    // temporal speed of convergence wave
#define LOGO_CONV_FREQ      0.05f   // spatial frequency of convergence wave
#define LOGO_CONV_DITHER    0.001f  // per-particle phase offset

static sprite_t logo_sprite;
static bool logo_ready = false;
static float logo_time = 0.0f;

// display dimensions
static int logo_dw = 0;
static int logo_dh = 0;
static int logo_dx = 0;
static int logo_dy = 0;

// particle arrays (SDRAM on Zephyr, regular memory on Emscripten)
#define MAX_LOGO_PARTICLES 40000

static float logo_sx[MAX_LOGO_PARTICLES] SDRAM_BSS;
static float logo_sy[MAX_LOGO_PARTICLES] SDRAM_BSS;
static float logo_ex[MAX_LOGO_PARTICLES] SDRAM_BSS;
static float logo_ey[MAX_LOGO_PARTICLES] SDRAM_BSS;
static uint16_t logo_color[MAX_LOGO_PARTICLES] SDRAM_BSS;

static int logo_num = 0;

// scale logo, extract non-transparent pixels into particle arrays
static void logo_build_particles(void)
{
    logo_dw = (int)(SCREEN_W * LOGO_SCALE);
    logo_dh = logo_dw * logo_sprite.h / logo_sprite.w;
    logo_dx = (SCREEN_W - logo_dw) / 2;
    logo_dy = (SCREEN_H - logo_dh) / 2 + LOGO_Y_OFFSET;

    // count non-transparent pixels at display resolution
    int count = 0;
    for (int y = 0; y < logo_dh; y++) {
        int src_y = y * logo_sprite.h / logo_dh;
        for (int x = 0; x < logo_dw; x++) {
            int src_x = x * logo_sprite.w / logo_dw;
            if (logo_sprite.pixels[src_y * logo_sprite.w + src_x] != logo_sprite.color_key) {
                count++;
            }
        }
    }

    if (count > MAX_LOGO_PARTICLES) count = MAX_LOGO_PARTICLES;
    logo_num = count;

    // fill end positions and colors
    int idx = 0;
    for (int y = 0; y < logo_dh && idx < logo_num; y++) {
        int src_y = y * logo_sprite.h / logo_dh;
        for (int x = 0; x < logo_dw && idx < logo_num; x++) {
            int src_x = x * logo_sprite.w / logo_dw;
            uint16_t c = logo_sprite.pixels[src_y * logo_sprite.w + src_x];
            if (c != logo_sprite.color_key) {
                logo_ex[idx] = (float)(logo_dx + x);
                logo_ey[idx] = (float)(logo_dy + y);
                logo_color[idx] = c;
                idx++;
            }
        }
    }

    // generate evenly spaced start positions in a grid
    int cols = (int)ceilf(sqrtf((float)count * SCREEN_W / SCREEN_H));
    int rows = (int)ceilf((float)count / cols);
    float step_x = (float)SCREEN_W / cols;
    float step_y = (float)SCREEN_H / rows;

    for (int i = 0; i < count; i++) {
        int col = i % cols;
        int row = i / cols;
        logo_sx[i] = step_x * (col + 0.5f);
        logo_sy[i] = step_y * (row + 0.5f);
    }

    logo_ready = true;
}

// sine wave amplitude: ramps up during convergence, decays after settling
static float logo_wave_amp(void)
{
    if (logo_time < LOGO_ANIM_TIME) {
        float t = logo_time / LOGO_ANIM_TIME;
        return LOGO_WAVE_MAX * t;
    }
    if (logo_time < LOGO_TOTAL_TIME) {
        float t = (logo_time - LOGO_ANIM_TIME) / LOGO_WAVE_TIME;
        return LOGO_WAVE_MAX * (1.0f - t);
    }
    return 0.0f;
}

// periodic shake: sin-envelope pulse every LOGO_SHAKE_INTERVAL seconds
static float logo_shake_amp(void)
{
    float elapsed = logo_time - LOGO_TOTAL_TIME;
    if (elapsed < LOGO_SHAKE_INTERVAL) return 0.0f;
    float cycle = fmodf(elapsed, LOGO_SHAKE_INTERVAL);
    if (cycle >= LOGO_SHAKE_DURATION) return 0.0f;
    float t = cycle / LOGO_SHAKE_DURATION;
    float env = sinf(t * (float)M_PI);
    return LOGO_SHAKE_AMP * env;
}

// load logo from flash data and build particle arrays
void logo_init(void)
{
    logo_sprite.w = LOGO_W;
    logo_sprite.h = LOGO_H;
    logo_sprite.color_key = LOGO_COLOR_KEY;
    logo_sprite.pixels = logo_pixels;
    logo_build_particles();
}

// true when convergence + wave animation has finished
bool logo_is_done(void)
{
    return logo_ready && logo_time >= LOGO_TOTAL_TIME;
}

// advance logo animation timer
void logo_update(float dt)
{
    if (!logo_ready) return;
    logo_time += dt;
}

// render logo: particles during convergence, sprite + shake after
void logo_draw(void)
{
    if (!logo_ready) return;

    // animation fully done — static or periodic shake
    if (logo_time >= LOGO_TOTAL_TIME) {
        float shake = logo_shake_amp();
        if (shake < 0.01f) {
            sprite_blit_scaled(&logo_sprite, logo_dx, logo_dy, logo_dw, logo_dh);
        } else {
            // per-row sine distortion
            for (int y = 0; y < logo_dh; y++) {
                int sy = logo_dy + y;
                if ((unsigned)sy >= SCREEN_H) continue;
                int src_y = y * logo_sprite.h / logo_dh;
                int ox = (int)(shake * sinf(sy * LOGO_SHAKE_FREQ + logo_time * LOGO_SHAKE_SPEED));
                int fb_row = sy * SCREEN_W;
                for (int x = 0; x < logo_dw; x++) {
                    int sx = logo_dx + x + ox;
                    if ((unsigned)sx >= SCREEN_W) continue;
                    int src_x = x * logo_sprite.w / logo_dw;
                    uint16_t c = logo_sprite.pixels[src_y * logo_sprite.w + src_x];
                    if (c != logo_sprite.color_key) {
                        fb_back[fb_row + sx] = c;
                    }
                }
            }
        }
        return;
    }

    // convergence + wave
    float t = logo_time / LOGO_ANIM_TIME;
    if (t > 1.0f) t = 1.0f;
    float e = t * (2.0f - t);
    float amp = logo_wave_amp();
    float phase = logo_time * LOGO_CONV_SPEED;

    for (int i = 0; i < logo_num; i++) {
        float x = logo_sx[i] + (logo_ex[i] - logo_sx[i]) * e;
        float y = logo_sy[i] + (logo_ey[i] - logo_sy[i]) * e;
        float wave = amp * sinf(y * LOGO_CONV_FREQ + phase + i * LOGO_CONV_DITHER);
        putpixel((int)(x + wave), (int)y, logo_color[i]);
    }
}
```

## src/logo.h
```c
#ifndef LOGO_EFFECT_H
#define LOGO_EFFECT_H

#include <stdbool.h>

// load logo from flash data and build particle arrays
void logo_init(void);

// advance logo animation timer
void logo_update(float dt);

// render logo: particles during convergence, sprite + shake after
void logo_draw(void);

// true when convergence + wave animation has finished
bool logo_is_done(void);

#endif
```

## src/prng.h
```c
#ifndef PRNG_H
#define PRNG_H

#include <stdint.h>

// Knuth LCG constants
#define LCG_MUL 1664525u
#define LCG_INC 1013904223u

// advance LCG state and return upper 16 bits
static inline uint32_t lcg_next(uint32_t *state)
{
    *state = *state * LCG_MUL + LCG_INC;
    return *state >> 16;
}

#endif
```
